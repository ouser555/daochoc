## user config/nelsonhsw/daochoc/Kconfig.defconfig
```kconfig
# Copyright (c) 2020 The ZMK Contributors
# SPDX-License-Identifier: MIT

if SHIELD_DAOCHOC_LEFT

config ZMK_KEYBOARD_NAME
	default "Daochoc"

config ZMK_SPLIT_BLE_ROLE_CENTRAL
	default y

endif

if SHIELD_DAOCHOC_LEFT || SHIELD_DAOCHOC_RIGHT

config ZMK_SPLIT
	default y

endif
```

## user config/nelsonhsw/daochoc/Kconfig.shield
```kconfig
# Copyright (c) 2020 The ZMK Contributors
# SPDX-License-Identifier: MIT

config SHIELD_DAOCHOC_LEFT
	def_bool $(shields_list_contains,daochoc_left)

config SHIELD_DAOCHOC_RIGHT
	def_bool $(shields_list_contains,daochoc_right)
```
